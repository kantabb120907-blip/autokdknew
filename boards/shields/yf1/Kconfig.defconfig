## boards/shields/yf1/Kconfig.defconfig
```kconfig
if SHIELD_YF1_LEFT

config ZMK_KEYBOARD_NAME
    default "yf1"

endif

if SHIELD_YF1_LEFT || SHIELD_YF1_RIGHT

config ZMK_SPLIT
    default y

endif
```

## boards/shields/yf1/Kconfig.shield
```kconfig
config SHIELD_YF1_LEFT
    def_bool $(shields_list_contains,yf1_left)
config SHIELD_YF1_RIGHT
    def_bool $(shields_list_contains,yf1_right)
```
